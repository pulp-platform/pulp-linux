## configs/cheshire_defconfig
```kconfig
BR2_riscv=y
BR2_riscv_custom=y
BR2_RISCV_ISA_RVM=y
BR2_RISCV_ISA_RVA=y
BR2_RISCV_ISA_RVF=y
BR2_RISCV_ISA_RVD=y
BR2_RISCV_ISA_RVC=y
BR2_BINUTILS_VERSION_2_41_X=y
BR2_GCC_VERSION_13_X=y
BR2_BACKUP_SITE="http://sources.buildroot.net"
BR2_CPAN_MIRROR="http://cpan.metacpan.org"
BR2_CCACHE=y
BR2_ROOTFS_OVERLAY="$(BR2_EXTERNAL_CVA6_LINUX_PATH)/target/common/rootfs"
BR2_LINUX_KERNEL=y
BR2_LINUX_KERNEL_CUSTOM_VERSION=y
BR2_LINUX_KERNEL_CUSTOM_VERSION_VALUE="6.7"
BR2_LINUX_KERNEL_PATCH="$(BR2_EXTERNAL_CVA6_LINUX_PATH)/target/common/patches/linux_v6.6_patch"
BR2_LINUX_KERNEL_USE_CUSTOM_CONFIG=y
BR2_LINUX_KERNEL_CUSTOM_CONFIG_FILE="$(BR2_EXTERNAL_CVA6_LINUX_PATH)/target/cheshire/linux64_defconfig"
BR2_PACKAGE_BUSYBOX_CONFIG="$(BR2_EXTERNAL_CVA6_LINUX_PATH)/target/cheshire/busybox64.config"
BR2_PACKAGE_DHRYSTONE=y
BR2_PACKAGE_LMBENCH=y
BR2_PACKAGE_MEMSTAT=y
BR2_PACKAGE_RT_TESTS=y
BR2_PACKAGE_WHETSTONE=y
BR2_PACKAGE_NFS_UTILS=y
BR2_PACKAGE_LIBNFS=y
BR2_PACKAGE_ETHTOOL=y
# BR2_PACKAGE_IFUPDOWN_SCRIPTS is not set
BR2_PACKAGE_IPERF3=y
BR2_PACKAGE_IPROUTE2=y
BR2_PACKAGE_TCPDUMP=y
BR2_TARGET_ROOTFS_CPIO_GZIP=y
BR2_TARGET_ROOTFS_INITRAMFS=y
# BR2_TARGET_ROOTFS_TAR is not set
BR2_TARGET_OPENSBI=y
BR2_TARGET_OPENSBI_CUSTOM_GIT=y
BR2_TARGET_OPENSBI_CUSTOM_REPO_URL="https://github.com/pulp-platform/opensbi"
BR2_TARGET_OPENSBI_CUSTOM_REPO_VERSION="bluewww/cheshire"
BR2_TARGET_OPENSBI_PLAT="fpga/cheshire"
# BR2_TARGET_OPENSBI_INSTALL_DYNAMIC_IMG is not set
# BR2_TARGET_OPENSBI_INSTALL_JUMP_IMG is not set
BR2_TARGET_OPENSBI_LINUX_PAYLOAD=y
BR2_TARGET_OPENSBI_ADDITIONAL_VARIABLES="FW_FDT_PATH=$(BR2_EXTERNAL_CVA6_LINUX_PATH)/target/cheshire/cheshire.dtb"
BR2_PACKAGE_CACHETEST=y
BR2_PACKAGE_VITETRIS=y
```

## package/cachetest/Config.in
```kconfig
config BR2_PACKAGE_CACHETEST
       bool "cachetest"
       help
	Simple cache testing benchmark.
```
