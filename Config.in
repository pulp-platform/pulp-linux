## Config.in
```kconfig
source "$BR2_EXTERNAL_CVA6_LINUX_PATH/package/cachetest/Config.in"
source "$BR2_EXTERNAL_CVA6_LINUX_PATH/package/idma-legacy/Config.in"
source "$BR2_EXTERNAL_CVA6_LINUX_PATH/package/idma-legacy-test/Config.in"
source "$BR2_EXTERNAL_CVA6_LINUX_PATH/package/vitetris/Config.in"
```

## configs/cheshire-fence_defconfig
```kconfig
BR2_riscv=y
BR2_riscv_custom=y
BR2_RISCV_ISA_RVM=y
BR2_RISCV_ISA_RVA=y
BR2_RISCV_ISA_RVF=y
BR2_RISCV_ISA_RVD=y
BR2_RISCV_ISA_RVC=y
BR2_BINUTILS_VERSION_2_41_X=y
BR2_GCC_VERSION_13_X=y
BR2_BACKUP_SITE="http://sources.buildroot.net"
BR2_CPAN_MIRROR="http://cpan.metacpan.org"
BR2_GLOBAL_PATCH_DIR="$(BR2_EXTERNAL_CVA6_LINUX_PATH)/board/pulp/common/patches $(BR2_EXTERNAL_CVA6_LINUX_PATH)/board/pulp/cheshire-fence/patches"
BR2_ROOTFS_DEVICE_TABLE_SUPPORTS_EXTENDED_ATTRIBUTES=y
BR2_ROOTFS_OVERLAY="$(BR2_EXTERNAL_CVA6_LINUX_PATH)/board/pulp/common/rootfs"
BR2_ROOTFS_POST_IMAGE_SCRIPT="$(BR2_EXTERNAL_CVA6_LINUX_PATH)/board/pulp/common/post-image.sh"
BR2_LINUX_KERNEL=y
BR2_LINUX_KERNEL_CUSTOM_VERSION=y
BR2_LINUX_KERNEL_CUSTOM_VERSION_VALUE="6.7"
BR2_LINUX_KERNEL_USE_CUSTOM_CONFIG=y
BR2_LINUX_KERNEL_CUSTOM_CONFIG_FILE="$(BR2_EXTERNAL_CVA6_LINUX_PATH)/board/pulp/common/linux.config"
BR2_LINUX_KERNEL_IMAGEGZ=y
BR2_PACKAGE_BUSYBOX_CONFIG="$(BR2_EXTERNAL_CVA6_LINUX_PATH)/board/pulp/common/busybox.config"
BR2_PACKAGE_DHRYSTONE=y
BR2_PACKAGE_LMBENCH=y
BR2_PACKAGE_MEMSTAT=y
BR2_PACKAGE_RT_TESTS=y
BR2_PACKAGE_WHETSTONE=y
BR2_PACKAGE_NFS_UTILS=y
BR2_PACKAGE_LIBNFS=y
BR2_PACKAGE_ETHTOOL=y
# BR2_PACKAGE_IFUPDOWN_SCRIPTS is not set
BR2_PACKAGE_IPERF3=y
BR2_PACKAGE_IPROUTE2=y
BR2_PACKAGE_TCPDUMP=y
BR2_TARGET_ROOTFS_CPIO_GZIP=y
BR2_TARGET_ROOTFS_INITRAMFS=y
# BR2_TARGET_ROOTFS_TAR is not set
BR2_TARGET_OPENSBI=y
BR2_TARGET_OPENSBI_CUSTOM_VERSION=y
BR2_TARGET_OPENSBI_CUSTOM_VERSION_VALUE="1.4"
BR2_TARGET_OPENSBI_PLAT="fpga/cheshire"
# BR2_TARGET_OPENSBI_INSTALL_DYNAMIC_IMG is not set
# BR2_TARGET_OPENSBI_INSTALL_JUMP_IMG is not set
BR2_TARGET_OPENSBI_UBOOT_PAYLOAD=y
BR2_TARGET_UBOOT=y
BR2_TARGET_UBOOT_BOARDNAME="pulp-platform_cheshire"
BR2_TARGET_UBOOT_CUSTOM_VERSION=y
BR2_TARGET_UBOOT_CUSTOM_VERSION_VALUE="2021.07"
BR2_PACKAGE_HOST_UBOOT_TOOLS=y
BR2_PACKAGE_CACHETEST=y
BR2_PACKAGE_IDMA_LEGACY=y
BR2_PACKAGE_IDMA_LEGACY_TEST=y
BR2_PACKAGE_VITETRIS=y
```

## configs/cheshire.vcu128.desktop_defconfig
```kconfig
BR2_riscv=y
BR2_RISCV_ISA_RVC=y
BR2_PACKAGE_HOST_LINUX_HEADERS_CUSTOM_6_6=y
BR2_BINUTILS_VERSION_2_42_X=y
BR2_TOOLCHAIN_BUILDROOT_CXX=y
BR2_TARGET_OPTIMIZATION="-frename-registers"
BR2_BACKUP_SITE="http://sources.buildroot.net"
BR2_CPAN_MIRROR="http://cpan.metacpan.org"
BR2_CCACHE=y
BR2_CCACHE_DIR="$(TOPDIR)/buildroot-ccache"
BR2_OPTIMIZE_3=y
BR2_ENABLE_LTO=y
BR2_TARGET_GENERIC_ISSUE="Welcome to PULP Linux"
BR2_ROOTFS_DEVICE_CREATION_DYNAMIC_EUDEV=y
BR2_ROOTFS_OVERLAY="$(BR2_EXTERNAL_PULP_PATH)/target/common/rootfs"
BR2_ROOTFS_PRE_BUILD_SCRIPT="$(BR2_EXTERNAL_PULP_PATH)/target/common/pre-build.sh"
BR2_ROOTFS_POST_IMAGE_SCRIPT="$(BR2_EXTERNAL_PULP_PATH)/target/common/post-image.sh"
BR2_ROOTFS_PRE_BUILD_SCRIPT_ARGS="$(BR2_EXTERNAL_PULP_PATH)/target/vcu128/cheshire.vcu128.dts $(BR2_EXTERNAL_PULP_PATH)/target/genesys2/cheshire.genesys2.dts $(BR2_EXTERNAL_PULP_PATH)/target/common/cheshire.dtsi"
BR2_LINUX_KERNEL=y
BR2_LINUX_KERNEL_CUSTOM_VERSION=y
BR2_LINUX_KERNEL_CUSTOM_VERSION_VALUE="6.6.52"
BR2_LINUX_KERNEL_PATCH="$(BR2_EXTERNAL_PULP_PATH)/target/common/patches/linux"
BR2_LINUX_KERNEL_USE_CUSTOM_CONFIG=y
BR2_LINUX_KERNEL_CUSTOM_CONFIG_FILE="$(BR2_EXTERNAL_PULP_PATH)/target/common/cheshire.desktop_linux64_defconfig"
BR2_LINUX_KERNEL_IMAGEGZ=y
BR2_PACKAGE_BUSYBOX_CONFIG="$(BR2_EXTERNAL_PULP_PATH)/target/common/cheshire.desktop_busybox64.config"
BR2_PACKAGE_ALSA_UTILS=y
BR2_PACKAGE_ALSA_UTILS_APLAY=y
BR2_PACKAGE_MPG123=y
BR2_PACKAGE_DHRYSTONE=y
BR2_PACKAGE_LMBENCH=y
BR2_PACKAGE_MEMSTAT=y
BR2_PACKAGE_RT_TESTS=y
BR2_PACKAGE_WHETSTONE=y
BR2_PACKAGE_NFS_UTILS=y
BR2_PACKAGE_XORG7=y
BR2_PACKAGE_XSERVER_XORG_SERVER=y
BR2_PACKAGE_XAPP_TWM=y
BR2_PACKAGE_XAPP_XCALC=y
BR2_PACKAGE_XAPP_XCLOCK=y
BR2_PACKAGE_XAPP_XCONSOLE=y
BR2_PACKAGE_XAPP_XINIT=y
BR2_PACKAGE_XAPP_XINPUT=y
BR2_PACKAGE_XAPP_XMODMAP=y
BR2_PACKAGE_XAPP_XRANDR=y
BR2_PACKAGE_XDRIVER_XF86_VIDEO_FBDEV=y
BR2_PACKAGE_XUTIL_MAKEDEPEND=y
BR2_PACKAGE_XTERM=y
BR2_PACKAGE_LIBNFS=y
BR2_PACKAGE_LIBSVG_CAIRO=y
BR2_PACKAGE_ETHTOOL=y
# BR2_PACKAGE_IFUPDOWN_SCRIPTS is not set
BR2_PACKAGE_IPERF3=y
BR2_PACKAGE_IPROUTE2=y
BR2_PACKAGE_TCPDUMP=y
BR2_TARGET_ROOTFS_CPIO_GZIP=y
BR2_TARGET_ROOTFS_INITRAMFS=y
# BR2_TARGET_ROOTFS_TAR is not set
BR2_TARGET_OPENSBI=y
BR2_TARGET_OPENSBI_CUSTOM_GIT=y
BR2_TARGET_OPENSBI_CUSTOM_REPO_URL="https://github.com/pulp-platform/opensbi"
BR2_TARGET_OPENSBI_CUSTOM_REPO_VERSION="bluewww/cheshire"
BR2_TARGET_OPENSBI_PLAT="fpga/cheshire"
# BR2_TARGET_OPENSBI_INSTALL_DYNAMIC_IMG is not set
# BR2_TARGET_OPENSBI_INSTALL_JUMP_IMG is not set
BR2_TARGET_OPENSBI_UBOOT_PAYLOAD=y
BR2_TARGET_OPENSBI_ADDITIONAL_VARIABLES="FW_FDT_PATH=$(BINARIES_DIR)/cheshire.dtb"
BR2_TARGET_UBOOT=y
BR2_TARGET_UBOOT_BUILD_SYSTEM_KCONFIG=y
BR2_TARGET_UBOOT_CUSTOM_GIT=y
BR2_TARGET_UBOOT_CUSTOM_REPO_URL="https://github.com/pulp-platform/u-boot"
BR2_TARGET_UBOOT_CUSTOM_REPO_VERSION="cheshire"
BR2_TARGET_UBOOT_BOARD_DEFCONFIG="pulp-platform_cheshire"
BR2_PACKAGE_HOST_GENIMAGE=y
BR2_PACKAGE_CACHETEST=y
BR2_PACKAGE_VITETRIS=y
```

## package/cacheprobe/Config.in
```kconfig
config BR2_PACKAGE_CACHEPROBE
       bool "cacheprobe"
       help
	Cache pointer-chase (latency test) and stream (bandwidth test) workload
```

## package/idma-legacy-test/Config.in
```kconfig
config BR2_PACKAGE_IDMA_LEGACY_TEST
	bool "idma-legacy-test"
	depends on BR2_LINUX_KERNEL
	select BR2_PACKAGE_IDMA_LEGACY
	help
	  Small userspace program to open /dev/idma_legacy, query the ABI
	  version, and run an IOCTL memcpy with two user heap buffers.

if BR2_PACKAGE_IDMA_LEGACY_TEST

config BR2_PACKAGE_IDMA_LEGACY_TEST_EXPECT_CMO
	bool "expect CMO (Zicbom) for coherency"
	default n
	help
	  When enabled, the test issues cbo.flush / cbo.inval around DMA and
	  checks that fence-only coherency fails as expected.

	  Disable on platforms without cache management op support when the
	  DMA path still works with a simple fence + non-coherent caches.

endif
```

## package/idma-legacy/Config.in
```kconfig
config BR2_PACKAGE_IDMA_LEGACY
	bool "idma-legacy"
	depends on BR2_LINUX_KERNEL
	help
	  Out-of-tree placeholder for the idma-legacy kernel driver (skeleton).
```

## package/idma-reg-kmod/Config.in
```kconfig
config BR2_PACKAGE_IDMA_REG_KMOD
    bool "iDMA reg kernel module"
    depends on BR2_LINUX_KERNEL
    help
      iDMA driver kernel module that uses the vanilla reg hardware interface.
```

## package/idma-test/Config.in
```kconfig
config BR2_PACKAGE_IDMA_TEST
	bool "idma-test"
	depends on BR2_LINUX_KERNEL
	select BR2_PACKAGE_IDMA
	help
	  Small userspace test program that opens the iDMA proxy character
	  device and issues an IOCTL memcpy using IDMA_COPY_BUFFER (user
	  buffers copied in the kernel around the DMA).
```

## package/idma/Config.in
```kconfig
config BR2_PACKAGE_IDMA
	bool "idma"
	depends on BR2_LINUX_KERNEL
	help
	  Build the Cheshire iDMA DMA engine and proxy drivers as
	  out-of-tree Linux kernel modules.
```

## package/llcpart-kmod/Config.in
```kconfig
config BR2_PACKAGE_LLPART_KMOD
    bool "LLC partitioning kernel module"
    depends on BR2_LINUX_KERNEL
    help
      PULP AXI LLC and LLC partitioning kernel driver.
```

## package/rt-bench/Config.in
```kconfig
config BR2_PACKAGE_RT_BENCH
	bool "rt-bench"
	depends on BR2_TOOLCHAIN_HAS_THREADS
	select BR2_PACKAGE_JSON_C
	help
	  RT-Bench: an extensible benchmark framework for real-time
	  applications, including TACLeBench, SD-VBS and IsolBench
	  based benchmarks. :contentReference[oaicite:3]{index=3}

	  This package fetches the rt-bench framework from GitLab
	  and uses its top-level Makefile (setup-*/compile-* targets)
	  to build all integrated benchmark suites, then installs the
	  resulting executables into /usr/bin on the target.
```

## package/tacle-bench/Config.in
```kconfig
config BR2_PACKAGE_TACLE_BENCH
	bool "tacle-bench"
	help
	  TACLe benchmark collection.

	  This package builds the pulp-platform fork of TACLeBench
	  (branch bluew/build) and installs the generated benchmark
	  binaries into /usr/bin on the target. :contentReference[oaicite:0]{index=0}
```

## target/cheshire/linux64_defconfig
```kconfig
CONFIG_DEFAULT_HOSTNAME="cheshire-fpga"
# CONFIG_CROSS_MEMORY_ATTACH is not set
CONFIG_BLK_DEV_INITRD=y
CONFIG_INITRAMFS_SOURCE="${BR_BINARIES_DIR}/rootfs.cpio"
CONFIG_NONPORTABLE=y
CONFIG_SMP=y
# CONFIG_RISCV_ISA_SVNAPOT is not set
# CONFIG_RISCV_ISA_SVPBMT is not set
# CONFIG_RISCV_ISA_V is not set
# CONFIG_RISCV_ISA_ZBB is not set
CONFIG_RISCV_ISA_ZICBOM=y
CONFIG_RISCV_DMA_NONCOHERENT=y
# CONFIG_RISCV_ISA_ZICBOZ is not set
CONFIG_HZ_100=y
CONFIG_RISCV_SBI_V01=y
# CONFIG_RISCV_BOOT_SPINWAIT is not set
CONFIG_CMDLINE="debug loglevel=7 earlycon=sbi"
# CONFIG_EFI is not set
# CONFIG_SUSPEND is not set
# CONFIG_GCC_PLUGINS is not set
CONFIG_MODULES=y
CONFIG_PARTITION_ADVANCED=y
# CONFIG_COMPACTION is not set
CONFIG_DEVTMPFS=y
CONFIG_DEVTMPFS_MOUNT=y
CONFIG_VIRTIO_BLK=y
CONFIG_EEPROM_AT24=y
# CONFIG_INPUT_KEYBOARD is not set
# CONFIG_INPUT_MOUSE is not set
CONFIG_SERIAL_8250=y
CONFIG_SERIAL_8250_CONSOLE=y
CONFIG_SERIAL_OF_PLATFORM=y
CONFIG_SERIAL_EARLYCON_RISCV_SBI=y
CONFIG_SERIAL_UARTLITE=y
CONFIG_VIRTIO_CONSOLE=y
# CONFIG_HW_RANDOM is not set
CONFIG_I2C=y
CONFIG_I2C_OCORES=y
CONFIG_SPI=y
CONFIG_SPI_OPENTITAN_QSPI=y
CONFIG_POWER_RESET=y
CONFIG_MMC=y
CONFIG_MMC_DEBUG=y
CONFIG_MMC_BLOCK=y
CONFIG_MMC_SPI=y
CONFIG_VIRTIO_MMIO=y
# CONFIG_IOMMU_SUPPORT is not set
CONFIG_PWM=y
CONFIG_EXT3_FS=y
CONFIG_EXT4_DEBUG=y
CONFIG_TMPFS=y
# CONFIG_MISC_FILESYSTEMS is not set
CONFIG_CRYPTO_ECHAINIV=y
CONFIG_PRINTK_TIME=y
CONFIG_DEBUG_KERNEL=y
CONFIG_DEBUG_INFO_DWARF_TOOLCHAIN_DEFAULT=y
CONFIG_GDB_SCRIPTS=y
# CONFIG_FTRACE is not set
#
CONFIG_NAMESPACES=y
CONFIG_EXPERT=y
CONFIG_HZ_1000=y
CONFIG_COMPAT_32BIT_TIME=y
CONFIG_NET=y
CONFIG_PACKET=y
CONFIG_UNIX=y
CONFIG_INET=y
CONFIG_SCSI=y
CONFIG_BLK_DEV_SD=y
CONFIG_BLK_DEV_SR=m
CONFIG_CHR_DEV_SG=m
CONFIG_NETDEVICES=y
CONFIG_USB_USBNET=m
CONFIG_INPUT_MOUSEDEV=y
CONFIG_INPUT_MOUSEDEV_SCREEN_X=640
CONFIG_INPUT_MOUSEDEV_SCREEN_Y=480
CONFIG_INPUT_EVDEV=m
CONFIG_I2C=y
CONFIG_I2C_OCORES=y
#CONFIG_SPI_DEBUG=y
CONFIG_FB=y
CONFIG_FB_SIMPLE=y
CONFIG_FRAMEBUFFER_CONSOLE=y
CONFIG_SOUND=y
CONFIG_SND=y
CONFIG_SND_USB_AUDIO=m
CONFIG_HIDRAW=y
CONFIG_UHID=m
CONFIG_HID_ALPS=m
# CONFIG_I2C_HID is not set
CONFIG_USB=y
CONFIG_USB_ANNOUNCE_NEW_DEVICES=y
CONFIG_USB_OHCI_HCD=y
CONFIG_USB_OHCI_HCD_PLATFORM=y
CONFIG_USB_STORAGE=y
CONFIG_MSDOS_FS=m
CONFIG_VFAT_FS=m
# CONFIG_PROC_PAGE_MONITOR is not set
CONFIG_NFSD=y
CONFIG_LSM="lockdown,yama,loadpin,safesetid,integrity,bpf"
CONFIG_INIT_STACK_NONE=y
CONFIG_CRYPTO_SHA256=y
# CONFIG_CRYPTO_HW is not set
CONFIG_STRIP_ASM_SYMS=y
CONFIG_DEBUG_SECTION_MISMATCH=y
CONFIG_DEBUG_FS=y
# CONFIG_FTRACE is not set
CONFIG_STACKTRACE=y
#
CONFIG_OF_RESERVED_MEM=y
CONFIG_DMA_DECLARE_COHERENT=y
CONFIG_RISCV_ALTERNATIVE=y
CONFIG_DMA_GLOBAL_POOL=y
#
CONFIG_TRACING=y
CONFIG_FTRACE=y
CONFIG_FUNCTION_TRACER=y
CONFIG_ARCH_NCIO_NCCMEM=y
CONFIG_NONPORTABLE=y
#
#
CONFIG_TRACE_EVENTS=y
CONFIG_FUNCTION_TRACER=y
CONFIG_DMA_API_DEBUG=y
#
CONFIG_MSDOS_PARTITION=y
CONFIG_EFI_PARTITION=y
#
CONFIG_MTD=y
CONFIG_MTD_SPI_NOR=y
CONFIG_SPI_MEM=y
CONFIG_MTD_CHAR=y
CONFIG_MTD_BLOCK=y
CONFIG_MTD_PARTITIONS=y
CONFIG_MTD_OF_PARTS=y
```

## target/common/cheshire.desktop_linux64_defconfig
```kconfig
CONFIG_DEFAULT_HOSTNAME="cheshire-fpga"
# CONFIG_CROSS_MEMORY_ATTACH is not set
CONFIG_NAMESPACES=y
CONFIG_BLK_DEV_INITRD=y
CONFIG_INITRAMFS_SOURCE="${BR_BINARIES_DIR}/rootfs.cpio"
CONFIG_EXPERT=y
CONFIG_SMP=y
CONFIG_NR_CPUS=8
# CONFIG_RISCV_ISA_V is not set
CONFIG_HZ_1000=y
CONFIG_RISCV_SBI_V01=y
# CONFIG_COMPAT is not set
CONFIG_CMDLINE="debug loglevel=7 earlycon=sbi"
# CONFIG_SUSPEND is not set
CONFIG_COMPAT_32BIT_TIME=y
# CONFIG_GCC_PLUGINS is not set
CONFIG_MODULES=y
CONFIG_PARTITION_ADVANCED=y
# CONFIG_IOSCHED_BFQ is not set
# CONFIG_COMPACTION is not set
CONFIG_NET=y
CONFIG_PACKET=y
CONFIG_UNIX=y
CONFIG_INET=y
CONFIG_DEVTMPFS=y
CONFIG_DEVTMPFS_MOUNT=y
CONFIG_VIRTIO_BLK=y
CONFIG_EEPROM_AT24=y
CONFIG_SCSI=y
CONFIG_BLK_DEV_SD=y
CONFIG_BLK_DEV_SR=m
CONFIG_CHR_DEV_SG=m
# CONFIG_BLK_DEV_BSG is not set
CONFIG_NETDEVICES=y
# CONFIG_ETHERNET is not set
CONFIG_USB_USBNET=y
# CONFIG_USB_NET_AX88179_178A is not set
CONFIG_INPUT_MOUSEDEV=y
CONFIG_INPUT_MOUSEDEV_SCREEN_X=640
CONFIG_INPUT_MOUSEDEV_SCREEN_Y=480
CONFIG_INPUT_EVDEV=y
# CONFIG_INPUT_KEYBOARD is not set
# CONFIG_INPUT_MOUSE is not set
CONFIG_SERIAL_8250=y
CONFIG_SERIAL_8250_CONSOLE=y
CONFIG_SERIAL_OF_PLATFORM=y
CONFIG_SERIAL_EARLYCON_RISCV_SBI=y
CONFIG_SERIAL_UARTLITE=y
CONFIG_VIRTIO_CONSOLE=y
# CONFIG_HW_RANDOM is not set
CONFIG_I2C=y
CONFIG_I2C_OCORES=y
CONFIG_SPI=y
CONFIG_SPI_DEBUG=y
CONFIG_SPI_OPENTITAN_QSPI=y
CONFIG_POWER_RESET=y
CONFIG_FB=y
CONFIG_FB_SIMPLE=y
# CONFIG_VGA_CONSOLE is not set
CONFIG_FRAMEBUFFER_CONSOLE=y
CONFIG_SOUND=y
CONFIG_SND=y
CONFIG_SND_USB_AUDIO=m
CONFIG_HIDRAW=y
CONFIG_UHID=m
CONFIG_HID_ALPS=m
# CONFIG_I2C_HID is not set
CONFIG_USB=y
CONFIG_USB_ANNOUNCE_NEW_DEVICES=y
CONFIG_USB_OHCI_HCD=y
CONFIG_USB_OHCI_HCD_PLATFORM=y
CONFIG_USB_STORAGE=y
CONFIG_MMC=y
CONFIG_MMC_DEBUG=y
CONFIG_MMC_SPI=y
CONFIG_VIRTIO_MMIO=y
# CONFIG_IOMMU_SUPPORT is not set
CONFIG_PWM=y
CONFIG_EXT3_FS=y
CONFIG_EXT4_DEBUG=y
CONFIG_MSDOS_FS=m
CONFIG_VFAT_FS=m
# CONFIG_PROC_PAGE_MONITOR is not set
CONFIG_TMPFS=y
# CONFIG_MISC_FILESYSTEMS is not set
CONFIG_NFSD=y
CONFIG_LSM="lockdown,yama,loadpin,safesetid,integrity,bpf"
CONFIG_INIT_STACK_NONE=y
CONFIG_CRYPTO_ECHAINIV=y
CONFIG_CRYPTO_SHA256=y
# CONFIG_CRYPTO_HW is not set
CONFIG_PRINTK_TIME=y
CONFIG_DEBUG_INFO_DWARF_TOOLCHAIN_DEFAULT=y
CONFIG_GDB_SCRIPTS=y
CONFIG_STRIP_ASM_SYMS=y
CONFIG_DEBUG_SECTION_MISMATCH=y
CONFIG_DEBUG_FS=y
# CONFIG_FTRACE is not set
```

## target/common/cheshire.minimal_linux64_defconfig
```kconfig
CONFIG_DEFAULT_HOSTNAME="cheshire-fpga"
# CONFIG_CROSS_MEMORY_ATTACH is not set
CONFIG_BLK_DEV_INITRD=y
CONFIG_INITRAMFS_SOURCE="${BR_BINARIES_DIR}/rootfs.cpio"
CONFIG_EXPERT=y
CONFIG_SMP=y
CONFIG_NR_CPUS=8
# CONFIG_RISCV_ISA_V is not set
CONFIG_HZ_1000=y
CONFIG_RISCV_SBI_V01=y
# CONFIG_COMPAT is not set
CONFIG_CMDLINE="debug loglevel=7 earlycon=sbi"
# CONFIG_SUSPEND is not set
CONFIG_COMPAT_32BIT_TIME=y
# CONFIG_GCC_PLUGINS is not set
CONFIG_MODULES=y
CONFIG_PARTITION_ADVANCED=y
# CONFIG_IOSCHED_BFQ is not set
# CONFIG_COMPACTION is not set
CONFIG_DEVTMPFS=y
CONFIG_DEVTMPFS_MOUNT=y
CONFIG_VIRTIO_BLK=y
CONFIG_EEPROM_AT24=y
# CONFIG_INPUT_KEYBOARD is not set
# CONFIG_INPUT_MOUSE is not set
CONFIG_SERIAL_8250=y
CONFIG_SERIAL_8250_CONSOLE=y
CONFIG_SERIAL_OF_PLATFORM=y
CONFIG_SERIAL_EARLYCON_RISCV_SBI=y
CONFIG_SERIAL_UARTLITE=y
CONFIG_VIRTIO_CONSOLE=y
# CONFIG_HW_RANDOM is not set
CONFIG_I2C=y
CONFIG_I2C_OCORES=y
CONFIG_SPI=y
CONFIG_SPI_OPENTITAN_QSPI=y
CONFIG_POWER_RESET=y
# CONFIG_VGA_CONSOLE is not set
CONFIG_MMC=y
CONFIG_MMC_DEBUG=y
CONFIG_MMC_SPI=y
CONFIG_VIRTIO_MMIO=y
# CONFIG_IOMMU_SUPPORT is not set
CONFIG_PWM=y
CONFIG_EXT3_FS=y
CONFIG_EXT4_DEBUG=y
CONFIG_TMPFS=y
# CONFIG_MISC_FILESYSTEMS is not set
CONFIG_CRYPTO_ECHAINIV=y
CONFIG_PRINTK_TIME=y
CONFIG_DEBUG_INFO_DWARF_TOOLCHAIN_DEFAULT=y
CONFIG_GDB_SCRIPTS=y
# CONFIG_FTRACE is not set
```
